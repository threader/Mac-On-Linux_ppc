## src/netdriver/Kconfig
```kconfig
menu "Network drivers"

config TUN
	bool "Tun driver"
	default y
	help
	  Build the tun/tap kernel module 
	  2.4 kernels only, 2.6 kernels please use the kernel version instead

config TAP
	bool "Ethertap driver"
	default y
	help
	  Build the ethertap kernel module (obsolete - do not use)

config SHEEP
	bool "Sheep net driver"
	default y
	help
	  Build the sheep-net kernel module (Required for MacOS)

endmenu
```

## trunk/src/netdriver/Kconfig
```kconfig
menu "Network drivers"

config TUN
	bool "Tun driver"
	default y
	help
	  Build the tun/tap kernel module 
	  2.4 kernels only, 2.6 kernels please use the kernel version instead

config TAP
	bool "Ethertap driver"
	default n
	help
	  Build the ethertap kernel module (obsolete - do not use)

config SHEEP
	bool "Sheep net driver"
	default y
	help
	  Build the sheep-net kernel module, useful for supporting two
	  network devices at once (appletalk and tcp/ip for instance)

endmenu
```
